## Kconfig
```kconfig
# SPI driver configuration
#
# NOTE:  the reason this doesn't show SPI slave support is mostly that
# nobody's needed a slave side API yet.  The master-role API is not
# fully appropriate there, so it'd need some thought to do well.
#

config DS18B20_DALLAS
	tristate "DS18B20 dallas/maxin semiconductor."
	depends on ARM
	help
	 GPIO on DS18B20 configuration is(on omapl138) 
	 SDI -> GPIO[0,2]

config OLED
	tristate "OLED SPI Display"
	depends on SPI
	help
	 SPI0 ENABLE

config MPU6050
	tristate "MPU6050 I2C interface."
	depends on ARM
	help 
	 no help
```
